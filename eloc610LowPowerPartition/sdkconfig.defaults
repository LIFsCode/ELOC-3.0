## eloc610LowPowerPartition/sdkconfig.defaults
```kconfig
#
# SKD config
#

# This file contains a list of configuration
# that are DIFFERENT from the standard SDK


#
# Serial flasher config
#
CONFIG_ESPTOOLPY_FLASHSIZE_16MB=y
CONFIG_ESPTOOLPY_FLASHSIZE="16MB"

#
# Compiler options
#
CONFIG_COMPILER_OPTIMIZATION_PERF=y

#
# Bluetooth
#
CONFIG_BT_ENABLED=y
CONFIG_BTDM_CTRL_MODE_BR_EDR_ONLY=y
CONFIG_BTDM_CTRL_BR_EDR_MAX_ACL_CONN=2
CONFIG_BTDM_CTRL_BR_EDR_MAX_SYNC_CONN=0
CONFIG_BTDM_CTRL_BR_EDR_SCO_DATA_PATH_PCM=y
CONFIG_BTDM_CTRL_BR_EDR_SCO_DATA_PATH_EFF=1
CONFIG_BTDM_CTRL_PCM_ROLE_EDGE_CONFIG=y
CONFIG_BTDM_CTRL_PCM_ROLE_MASTER=y
CONFIG_BTDM_CTRL_PCM_POLAR_FALLING_EDGE=y
CONFIG_BTDM_CTRL_LEGACY_AUTH_VENDOR_EVT=y
CONFIG_BTDM_CTRL_LEGACY_AUTH_VENDOR_EVT_EFF=y
CONFIG_BTDM_CTRL_BLE_MAX_CONN_EFF=0
CONFIG_BTDM_CTRL_BR_EDR_MAX_ACL_CONN_EFF=2
CONFIG_BTDM_CTRL_PINNED_TO_CORE_1=y
CONFIG_BTDM_CTRL_PINNED_TO_CORE=1

#
# Bluedroid Options
#
CONFIG_BT_BLUEDROID_PINNED_TO_CORE_1=y
CONFIG_BT_BLUEDROID_PINNED_TO_CORE=1
CONFIG_BT_CLASSIC_ENABLED=y
CONFIG_BT_SPP_ENABLED=y

#
# ESP32-specific
#
CONFIG_ESP32_ECO3_CACHE_LOCK_FIX=y
CONFIG_ESP32_DEFAULT_CPU_FREQ_80=y
CONFIG_ESP32_DEFAULT_CPU_FREQ_MHZ=80
CONFIG_ESP32_SPIRAM_SUPPORT=y
CONFIG_ESP32_TIME_SYSCALL_USE_RTC=y
CONFIG_ESP32_RTC_CLK_SRC_INT_8MD256=y

#
# SPI RAM config
#
CONFIG_SPIRAM_USE_CAPS_ALLOC=y

#
# SPIRAM workaround libraries placement
#
# CONFIG_SPIRAM_CACHE_LIBJMP_IN_IRAM is not set
# CONFIG_SPIRAM_CACHE_LIBMATH_IN_IRAM is not set
# CONFIG_SPIRAM_CACHE_LIBNUMPARSER_IN_IRAM is not set
# CONFIG_SPIRAM_CACHE_LIBIO_IN_IRAM is not set
# CONFIG_SPIRAM_CACHE_LIBTIME_IN_IRAM is not set
# CONFIG_SPIRAM_CACHE_LIBCHAR_IN_IRAM is not set
# CONFIG_SPIRAM_CACHE_LIBMEM_IN_IRAM is not set
# CONFIG_SPIRAM_CACHE_LIBSTR_IN_IRAM is not set
# CONFIG_SPIRAM_CACHE_LIBRAND_IN_IRAM is not set
# CONFIG_SPIRAM_CACHE_LIBENV_IN_IRAM is not set
# CONFIG_SPIRAM_CACHE_LIBFILE_IN_IRAM is not set
# CONFIG_SPIRAM_CACHE_LIBMISC_IN_IRAM is not set

#
# Sleep Config
#
# CONFIG_ESP_SLEEP_FLASH_LEAKAGE_WORKAROUND is not set

#
# Power Management
#
CONFIG_PM_ENABLE=y
CONFIG_PM_SLP_IRAM_OPT=y
CONFIG_PM_RTOS_IDLE_OPT=y
CONFIG_PM_SLP_DISABLE_GPIO=y

CONFIG_ESP_SYSTEM_CHECK_INT_LEVEL_5=y

#
# Wi-Fi
#
# Don't use this but seems to be ignored!
CONFIG_ESP32_WIFI_ENABLED=n

#
# FAT Filesystem support
#
CONFIG_FATFS_LFN_HEAP=y
CONFIG_FATFS_MAX_LFN=255
CONFIG_FATFS_API_ENCODING_ANSI_OEM=y
CONFIG_FATFS_ALLOC_PREFER_EXTRAM=y

#
# Modbus configuration
#
# Don't use this
CONFIG_FMB_COMM_MODE_TCP_EN=n

#
# FreeRTOS
#
CONFIG_FREERTOS_HZ=1000
CONFIG_FREERTOS_WATCHPOINT_END_OF_STACK=y
CONFIG_FREERTOS_USE_TRACE_FACILITY=y
CONFIG_FREERTOS_USE_STATS_FORMATTING_FUNCTIONS=y
CONFIG_FREERTOS_VTASKLIST_INCLUDE_COREID=y
CONFIG_FREERTOS_GENERATE_RUN_TIME_STATS=y
CONFIG_FREERTOS_RUN_TIME_STATS_USING_ESP_TIMER=y
CONFIG_FREERTOS_USE_TICKLESS_IDLE=y
CONFIG_FREERTOS_IDLE_TIME_BEFORE_SLEEP=3
```
